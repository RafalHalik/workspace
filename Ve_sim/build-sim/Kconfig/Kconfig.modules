## Ve_sim/build-sim/Kconfig/Kconfig.modules
```kconfig
menu "C4.3 (/home/user/C4.3_firmware/C4.3_workspace)"
osource "/home/user/C4.3_firmware/C4.3_workspace/Kconfig"
config ZEPHYR_C4_3_MODULE
	bool
	default y
endmenu
config ZEPHYR_MCUBOOT_C4_3_MODULE
   bool
   default y
menu "cmsis (/home/user/C4.3_firmware/modules/hal/cmsis)"
osource "$(ZEPHYR_CMSIS_KCONFIG)"
config ZEPHYR_CMSIS_MODULE
	bool
	default y
endmenu
menu "hal_nxp (/home/user/C4.3_firmware/modules/hal/nxp)"
osource "$(ZEPHYR_HAL_NXP_KCONFIG)"
config ZEPHYR_HAL_NXP_MODULE
	bool
	default y
endmenu
menu "lvgl (/home/user/C4.3_firmware/modules/lib/gui/lvgl)"
osource "/home/user/C4.3_firmware/modules/lib/gui/lvgl/Kconfig"
config ZEPHYR_LVGL_MODULE
	bool
	default y
endmenu
menu "mbedtls (/home/user/C4.3_firmware/modules/crypto/mbedtls)"
osource "$(ZEPHYR_MBEDTLS_KCONFIG)"
config ZEPHYR_MBEDTLS_MODULE
	bool
	default y
endmenu
config ZEPHYR_VEETHREE_SIM_MODULE
   bool
   default y
config ZEPHYR_BSP_MODULE
   bool
   default y
config ZEPHYR_NAFE_MODULE
   bool
   default y
```

## Ve_sim/build-sim/Kconfig/Kconfig.sysbuild.modules
```kconfig
config ZEPHYR_C4_3_MODULE
   bool
   default y
config ZEPHYR_MCUBOOT_C4_3_MODULE
   bool
   default y
config ZEPHYR_CMSIS_MODULE
   bool
   default y
config ZEPHYR_HAL_NXP_MODULE
   bool
   default y
config ZEPHYR_LVGL_MODULE
   bool
   default y
config ZEPHYR_MBEDTLS_MODULE
   bool
   default y
config ZEPHYR_VEETHREE_SIM_MODULE
   bool
   default y
config ZEPHYR_BSP_MODULE
   bool
   default y
config ZEPHYR_NAFE_MODULE
   bool
   default y
```

## Ve_sim/build-sim/Kconfig/arch/Kconfig
```kconfig
# Load arch Kconfig descriptions.
osource "/home/user/C4.3_firmware/zephyr/arch/x86/Kconfig"
osource "/home/user/C4.3_firmware/zephyr/arch/xtensa/Kconfig"
osource "/home/user/C4.3_firmware/zephyr/arch/sparc/Kconfig"
osource "/home/user/C4.3_firmware/zephyr/arch/riscv/Kconfig"
osource "/home/user/C4.3_firmware/zephyr/arch/posix/Kconfig"
osource "/home/user/C4.3_firmware/zephyr/arch/nios2/Kconfig"
osource "/home/user/C4.3_firmware/zephyr/arch/mips/Kconfig"
osource "/home/user/C4.3_firmware/zephyr/arch/arm64/Kconfig"
osource "/home/user/C4.3_firmware/zephyr/arch/arm/Kconfig"
osource "/home/user/C4.3_firmware/zephyr/arch/arc/Kconfig"
```

## Ve_sim/build/Kconfig/Kconfig.shield.defconfig
```kconfig
osource "/home/user/C4.3_firmware/C4.3_workspace/boards/shields/*/Kconfig.defconfig"
```

## bsp/Kconfig
```kconfig
#
# Copyright (c) 2020 Linumiz
#
# SPDX-License-Identifier: Apache-2.0
#


config BSP_AUTO_INIT
	bool "BSP auto init"
	default n
	help
	  Board Support Package.
```
